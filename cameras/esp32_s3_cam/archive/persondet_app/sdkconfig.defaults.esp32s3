## cameras/esp32_s3_cam/software/camlogger/main/Kconfig.projbuild
```kconfig
menu "camlogger"
    config CAM_WIFI_SSID
        string "WiFi SSID"
        default ""
    config CAM_WIFI_PASS
        string "WiFi password"
        default ""
    config CAM_SERVER_HOST
        string "sensorhub host/IP"
        default ""
    config CAM_SERVER_PORT
        int "sensorhub port"
        default 8088
    config CAM_DEVICE_NAME
        string "device name (blob path + firmware identity)"
        default "cam1"
    config CAM_CAPTURE_INTERVAL_S
        int "seconds between frames (recovery mode)"
        default 5
    config CAM_WAKE_INTERVAL_S
        int "deep-sleep wake interval, seconds"
        default 60
    config CAM_HEARTBEAT_EVERY_N
        int "transmit a heartbeat frame every N wakes"
        default 30
    config CAM_MOTION_THRESHOLD
        int "mean thumbnail diff (0-255) that counts as motion"
        default 8
    config CAM_GATE_THRESHOLD_PCT
        int "animal-gate transmit threshold, percent (recall-biased: low)"
        default 30
    config CAM_AUDIT_1_IN
        int "transmit 1 in N gate-rejected motion frames as audit samples"
        default 50
endmenu
```

## sensors/espnowbridge/main/Kconfig.projbuild
```kconfig
menu "espnowbridge"
    config BR_WIFI_SSID
        string "WiFi SSID"
        default ""
    config BR_WIFI_PASS
        string "WiFi password"
        default ""
    config BR_AP_BSSID
        string "primary router 2.4GHz BSSID to pin to (fixes the espnow channel)"
        default "7c:d9:5c:99:3b:2b"
    config BR_SERVER_HOST
        string "sensorhub host/IP"
        default ""
    config BR_SERVER_PORT
        int "sensorhub port"
        default 8088
    config BR_MIC_DEVICE
        string "device name audio chunks are posted under"
        default "xiaomic1"
    config BR_DEVICE_NAME
        string "this bridge's firmware identity for OTA"
        default "espnowbridge"
    config BR_MQTT_PASS
        string "mosquitto password for user espnow"
        default ""
endmenu
```

## sensors/espnowbridge/sdkconfig.defaults
```kconfig
# generic ESP32-S3 devkit (GD 32MB quad flash, CP2102N on UART0)
CONFIG_IDF_TARGET="esp32s3"
CONFIG_ESPTOOLPY_FLASHSIZE_16MB=y
CONFIG_ESPTOOLPY_FLASHMODE_DIO=y
CONFIG_ESP32S3_DEFAULT_CPU_FREQ_240=y
CONFIG_ESP_HTTPS_OTA_ALLOW_HTTP=y
CONFIG_BOOTLOADER_APP_ROLLBACK_ENABLE=y
CONFIG_PARTITION_TABLE_CUSTOM=y
CONFIG_PARTITION_TABLE_CUSTOM_FILENAME="partitions.csv"
CONFIG_PARTITION_TABLE_OFFSET=0xc000
CONFIG_ESP_MAIN_TASK_STACK_SIZE=12288
CONFIG_ESP32S3_SPIRAM_SUPPORT=y
CONFIG_SPIRAM_MODE_OCT=y
CONFIG_SPIRAM_SPEED_80M=y
CONFIG_SPIRAM_IGNORE_NOTFOUND=y
```

## sensors/espnowmeter/main/Kconfig.projbuild
```kconfig
menu "espnowmeter"
    config METER_CHANNEL
        int "ESP-NOW channel to sniff"
        default 1
    config METER_BRIDGE_MAC
        string "espnowbridge MAC (unicast SS reports)"
        default "38:44:be:cc:da:0c"
    config METER_LED_GPIO
        int "LED gpio"
        default 35
endmenu
```

## sensors/espnowmeter/sdkconfig.defaults
```kconfig
CONFIG_IDF_TARGET="esp32s3"
CONFIG_ESPTOOLPY_FLASHSIZE_8MB=y
CONFIG_ESPTOOLPY_FLASHMODE_DIO=y
CONFIG_ESP32S3_DEFAULT_CPU_FREQ_240=y
CONFIG_PARTITION_TABLE_SINGLE_APP=y
```

## sensors/miclogger/main/Kconfig.projbuild
```kconfig
menu "miclogger"
    config MIC_WIFI_SSID
        string "WiFi SSID"
        default ""
    config MIC_WIFI_PASS
        string "WiFi password"
        default ""
    config MIC_SERVER_HOST
        string "sensorhub host/IP"
        default ""
    config MIC_SERVER_PORT
        int "sensorhub port"
        default 8088
    config MIC_DEVICE_NAME
        string "device name (blob path + firmware identity)"
        default "xiaomic1"
    config MIC_SAMPLE_RATE
        int "sample rate, Hz"
        default 16000
    config MIC_CHUNK_S
        int "seconds of audio per POST"
        default 5
    config MIC_GAIN_SHIFT
        int "digital gain, bits (6dB each) after DC removal"
        default 4
    config MIC_BRIDGE_MAC
        string "espnowbridge devkit MAC (unicast ESP-NOW peer)"
        default "38:44:be:cc:da:0c"
    config MIC_RING_CHUNKS
        int "PSRAM ring depth, chunks (jitter cushion = depth * chunk_s)"
        default 24
    config MIC_POWER_PROBE
        bool "run the one-shot power-bank shutoff probe on new firmware"
        default n
endmenu
```
